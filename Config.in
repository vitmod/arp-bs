## Config.in
```kconfig
mainmenu "global config"
	
	config RM_WORK
	default n
	bool "remove temporary files in work dir ?"

	config DEBUG_ARP
	default n
	bool "Activate debug ?"

	config ENABLE_CCACHE
	default y
	bool "Activate ccache ?"



menu "Global Configuration"

	choice
		prompt "Target:"
		default SPARK
		help
		  Select box type

		config SPARK
		bool "SPARK"

		config SPARK7162
		bool "SPARK7162"

		config HL101
		bool "SpiderBox HL-101 (TODO)"
	endchoice

	choice
		prompt "Kernel:"
		default KERNEL_0211
		help
			Select kernel version

		config KERNEL_0211
		bool "STM 24 2.6.32.59-0211"

		config KERNEL_0215
		bool "STM 24 2.6.32.61-0215"

		config KERNEL_0217
		bool "STM 24 2.6.32.71-0217"
		select GIT_KERNEL_ARP
	endchoice

	config GIT_KERNEL_ARP
	bool "Build kernel from Git STlinux"



	choice
		prompt "toolchain building:"
		default GLIBC_SCRATCH
		help
		  select if use prebuilt binaries for toolchain at stage 1

		config GLIBC_BINARY
		bool "use prebuilt glibc sh4 binaries (TODO)"

		config GLIBC_SCRATCH
		bool "use only source files"

	endchoice

	choice
		prompt "Multicom:"
		default MULTICOM324

		config MULTICOM324
		bool "Multicom 3.2.4"

		config MULTICOM406
		bool "Multicom 4.0.6 (testing)"
	endchoice
	
	choice
		prompt "Player:"
		default PLAYER191

		config PLAYER191
		bool "Player 191"
	endchoice

	choice
		prompt "gcc libs from:"
		default GCC_LIB_FROM_TARGET

		config GCC_LIB_FROM_CROSS
		bool "cross-gcc"
		depends on AVOID_RPM_SPEC

		config GCC_LIB_FROM_TARGET
		bool "target-gcc"
	endchoice

	config AVOID_RPM_SPEC
		bool "don't use rpm spec if possible"
		default n
	
	choice
		prompt "Select GCC"
		default GCC47

		config GCC47
		bool "Build gcc 4.7.3"

		config GCC48
		bool "Build gcc 4.8.4"
	endchoice

	config MAKE_JLEVEL
		int "Number of jobs to run simultaneously"
		default "1"
		help
		  Number of jobs to run simultanesouly
	
	config TARGET_CFLAGS
		string "Target Optimizations C Flags"
		default "-O2"

	config TARGET_CXXFLAGS
		string "Target Optimizations C++ Flags"
		default "-O2"



	comment "Equipment:"
	
	config WLAN_SUPPORT
		bool "Wireless support"

	config 3G_SUPPORT
		bool "Support 3G modem"

	config NTFS_3G_SUPPORT
		bool "Support ntfs filesystem"

	config IPTABLES_SUPPORT
		bool "Iptables support"
	
	config EXTERNAL_LCD
		bool "External USB GraphLCD "

endmenu



menu "GUI Configuration"
	choice
		prompt "Media Framework:"
		default EPLAYER3

		config GSTREAMER
		bool "gstreamer (TODO)"

		config EPLAYER3
		bool "eplayer3"
	endchoice
	
	config GSTREAMER_GIT
		bool "gstreamer git version"
		depends on GSTREAMER

	config FEED_SPARK
		string "General URL for feed server"
		depends on SPARK
		default "src/gz spark-all http://gst.sat-universum.de" if GSTREAMER
		default "src/gz spark-all http://eplay.sat-universum.de" if EPLAYER3

	config FEED_SPARK7162
		string "General URL for feed server"
		depends on SPARK7162
		default "src/gz spark-all http://gst7162.sat-universum.de" if GSTREAMER
		default "src/gz spark-all http://eplay7162.sat-universum.de" if EPLAYER3

	config FEED_HL101
		string "General URL for feed server"
		depends on HL101
		default "src/gz hl101-all http://gsthl101.sat-universum.de" if GSTREAMER
		default "src/gz hl101-all http://eplayhl101.sat-universum.de" if EPLAYER3

	config NONFREE_FEED
		string "URL for nonfree plugins"
		default "src/gz non-free-feed http://nonfree.sat-universum.de"



	comment "Apps:"

	config BUILD_ENIGMA2
	bool "Enigma2"
	default y
	
	choice
		prompt "Enigma2 source:"
		default ENIGMA2_SRC_MASTER

		config ENIGMA2_SRC_MASTER
		bool "public branch master"

		config ENIGMA2_SRC_STAGING
		bool "public branch staging"

		config ENIGMA2_SRC_TAAPAT
		bool "enigma2 taapat on bitbucket"
	endchoice

	if BUILD_ENIGMA2

		config ENIGMA2_PLUGINS
		bool "enigma2-plugins-extra"
		default y
		depends on BUILD_ENIGMA2

		config ENIGMA2_EXTENSION_ALTSOFTCAM
		bool "enigma2-plugin-extensions-alternativesoftcammanager"

		config ENIGMA2_EXTENSION_WEBIF
		bool "enigma2-plugin-extensions-webinterface"
		depends on ENIGMA2_PLUGINS

		config ENIGMA2_EXTENSION_OPENWEBIF
		bool "enigma2-plugin-extensions-openwebif"

		config ENIGMA2_EXTENSION_MEDIAPORTAL
		bool "enigma2-plugin-extensions-mediaportal"

		config PYTHON_LIVESTREAMER
		bool "Livestreamer"

		config OSCAM
		bool "enigma2-plugin-cams-oscam"

		config ENIGMA2_SKINS
		bool "enigma2-skins-extra"
		default y
		depends on BUILD_ENIGMA2

		config ENIGMA2_SKIN_MEGAMOD
		bool "enigma2-plugin-skin-megamod"
		depends on ENIGMA2_SKINS

		config ENIGMA2_SKIN_MAGIC
		bool "enigma2-plugin-skin-magic"

		config ENIGMA2_SKIN_PLIHD
		bool "enigma2-plugin-skin-plihd"

		config ENIGMA2_SKIN_METROPOLISHD
		bool "enigma2-plugin-skin-metropolishd"

	endif # BUILD_ENIGMA2

	config SIGC2
	bool "experemental sigc++ 2.0"



	config BUILD_NEUTRINO
	bool "Neutrino"

	choice
		prompt "Neutrino source:"
		default NEUTRINO_SRC_MASTER

		config NEUTRINO_SRC_MASTER
		bool "public branch master"
		select SIGC2

		config NEUTRINO_SRC_MAX
		bool "public branch Max"
		select SIGC2
	endchoice

	config BUILD_XBMC
	bool "XBMC"

	choice
		prompt "XBMC source:"
		default XBMC_SRC_GIT

		config XBMC_SRC_GIT
		bool XBMC
	endchoice

	config BUILD_VDR
	bool "VDR"

endmenu
```
